#pragma once

namespace HPVM
{
	// -----------------------------------------------------------------------------
	// HP-35 Classic Virtual Machine
	// -----------------------------------------------------------------------------

	// clock parameters
	#define HPVM_CLOCK_RATE       (200) // kHz
	#define HPVM_BIT_TIME_WIDTH   (1000 / HPVM_CLOCK_RATE) // uS
	#define HPVM_BITS_PER_CYCLE   (14 * 4)
	#define HPVM_CYCLE_TIME_WIDTH (HPVM_BITS_PER_CYCLE * HPVM_BIT_TIME_WIDTH) // uS
	#define HPVM_CYCLES_PER_SEC   (1000000 / HPVM_CYCLE_TIME_WIDTH)

	// public interface
	void Operation(uint8_t op);
	bool Idling();    // true if idling
	bool Error();     // true if error occured
	bool Cycle();     // true if display updated
	char Display[15]; // display state

	// HP35 key operation
	enum
	{
		OpCLR  = 0x00, OpEXP  = 0x02, OpLN   = 0x03, OpLOG  = 0x04, OpPOW  = 0x06, OpRCL  = 0x08,
		OpSTO  = 0x0A, OpROT  = 0x0B, OpSWAP = 0x0C, OpINV  = 0x0E, OpNUM6 = 0x12, OpNUM5 = 0x13,
		OpNUM4 = 0x14, OpADD  = 0x16, OpNUM3 = 0x1A, OpNUM2 = 0x1B, OpNUM1 = 0x1C, OpMUL  = 0x1E,
		OpPI   = 0x22, OpDOT  = 0x23, OpNUM0 = 0x24, OpDIV  = 0x26, OpTAN  = 0x28, OpCOS  = 0x2A,
		OpSIN  = 0x2B, OpARC  = 0x2C, OpSQRT = 0x2E, OpNUM9 = 0x32, OpNUM8 = 0x33, OpNUM7 = 0x34,
		OpSUB  = 0x36, OpCLX  = 0x38, OpEEX  = 0x3A, OpCHS  = 0x3B, OpPUSH = 0x3E, OpNONE = 0xFF,
	};

	// HP35 firmware ROM (768 words)
	const uint8_t rom_l[] PROGMEM =
	{
		0xDD, 0xFF, 0x24, 0x17, 0x44, 0x44, 0x84, 0x10, 0xD1, 0xFB, 0x5F, 0xC3, 0xA8, 0x67, 0xEE, 0xE2,
		0x2E, 0x90, 0xEA, 0xEA, 0xEA, 0x6B, 0x69, 0xA8, 0xA8, 0xFF, 0xEA, 0xEA, 0xEA, 0x30, 0xCC, 0xAA,
		0xA8, 0x43, 0xD3, 0xCC, 0x30, 0x00, 0x83, 0x44, 0x44, 0xBB, 0x44, 0x9F, 0x84, 0x0B, 0x2E, 0x90,
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		0x7B, 0xFA, 0xCE, 0xEA, 0xCB, 0x9F, 0xCE, 0x0C, 0x98, 0xD8, 0x18, 0x98, 0x58, 0x07, 0x4C, 0xFB
	};

	const uint8_t rom_h[] PROGMEM =
	{
		0x28, 0x49, 0x0E, 0xED, 0xF0, 0x23, 0xF2, 0x03, 0x11, 0x40, 0x20, 0x0E, 0xFF, 0xE3, 0xBD, 0x14,
		0x9E, 0x7D, 0xFF, 0x44, 0x7A, 0x36, 0x71, 0xD0, 0x55, 0x54, 0xD7, 0x9C, 0x7B, 0xD2, 0x53, 0xC1,
		0x65, 0xCA, 0xB6, 0x44, 0xE4, 0x4C, 0x11, 0x5F, 0xF8, 0xB9, 0xE8, 0xA8, 0x38, 0x59, 0x44, 0x42,
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		0x7C, 0xB7, 0x7C, 0x8E, 0x97, 0xD3, 0x7E, 0x9C, 0x00, 0x29, 0xC5, 0x97, 0x65, 0xC7, 0x00, 0x59
	};

	// cpu defines
	typedef uint8_t digit;
	typedef digit reg[16];
	#define hpvm_iterate_word(a)  for (uint8_t i =  0; i <  14; ++i) { a; }
	#define hpvm_iterate_field(a) for (uint8_t i = ff; i <= fl; ++i) { a; }
	namespace fld { enum { P = 0, M, X, W, WP, MS, XS, S }; }
	const uint8_t arith_desc[] PROGMEM = { 0x01, 0x11, 0x22, 0x06, 0x39, 0x40, 0x12, 0x41, 0x50, 0x34, 0x60, 0x72, 0x32, 0x02, 0x80, 0x92, 0x21, 0xA0, 0xB2, 0x04, 0xB1, 0x81, 0xB0, 0x10, 0x61, 0xA1, 0x62, 0x70, 0x82, 0xA2, 0x83, 0x90 };
	const uint8_t field_bounds[] PROGMEM = { 0x00, 0x3C, 0x02, 0x0D, 0x00, 0x3D, 0x22, 0xDD };

	// display defines
	#define HPVM_DIGIT 0x00
	#define HPVM_SPACE 0x10
	#define HPVM_DASH  0x11
	#define HPVM_DOT   0x12

	// registers
	reg A;
	reg B;
	reg C; // X
	reg D; // Y
	reg E; // Z
	reg F; // T
	reg M;

	// state
	uint8_t rom, pc, ret_pc, key_pc;
	uint8_t p, ff, fl, s[12];
	uint8_t carry, prev_carry;
	uint8_t disp_enable, disp_update;
	uint8_t idling, error;

	// basic math
	__attribute__((noinline)) digit alu(digit x, digit y, uint8_t sub)
	{
		int8_t res;
		if (sub)
		{
			res = x - y - carry;
			if (res < 0) { res += 10; carry = 1; } else carry = 0;
		}
		else
		{
			res = x + y + carry;
			if (res > 9) { res -= 10; carry = 1; } else carry = 0;
		}
		return digit(res);
	}

	__attribute__((noinline)) void reg_clr(reg r, uint8_t first, uint8_t last)
	{
		for (uint8_t i = first; i <= last; ++i) r[i] = 0;
	}

	__attribute__((noinline)) void reg_math(reg r, reg x, digit *y, uint8_t sub)
	{
		for (uint8_t i = ff; i <= fl; ++i)
			r[i] = alu(x[i], y ? y[i] : 0, sub);
	}

	__attribute__((noinline)) void reg_shr(reg r)
	{
		for (uint8_t i = ff; i < fl; i++) r[i] = r[i + 1];
		r[fl] = 0;
	}

	void reg_shl(reg r)
	{
		for (int8_t i = fl; i > ff; i--) r[i] = r[i - 1];
		r[ff] = 0;
	}

	__attribute__((noinline)) void reg_move(reg x, reg y, uint8_t swap, uint8_t first, uint8_t last)
	{
		for (uint8_t i = first; i <= last; ++i)
		{
			digit t = x[i];
			x[i] = y[i];
			if (swap) y[i] = t;
		}
	}

	// implementation
	void Operation(uint8_t op)
	{
		idling = error = 0;
		key_pc = op;
		s[0] = 1;
	}

	bool Idling()
	{
		return (idling && s[8]);
	}

	bool Error()
	{
		return (error && Idling());
	}

	bool Cycle()
	{
		// handling state change breakpoints
		if (rom == 0x00)
		{
			if (pc == 0xC5) idling = 1;
			if (pc == 0xBF) error  = 1;
		}

		// fetch ROM
		uint16_t addr_l  = (uint16_t(rom) << 8 | pc);
		uint8_t  addr_h  = (addr_l >> 2);
		uint8_t  shift   = (addr_l & 0x03) << 1;
		uint8_t  fetch_l = pgm_read_byte(rom_l + addr_l);
		uint8_t  fetch_h = pgm_read_byte(rom_h + addr_h) >> shift & 0x03;

		prev_carry = carry;
		carry = 0;
		pc++;

		// operation decode
		uint8_t op_type = (fetch_l & 0x03);
		uint8_t op_code = (fetch_l >> 2 | fetch_h << 6);

		// Type 00: Misc Instructions
		if (op_type == 0x00)
		{
			switch(op_code)
			{
				case 0b00000000: // NO OPERATION
					break;
				case 0b00110100: // KEY -> ROM ADDRESS
					pc = key_pc;
					break;
				case 0b00000111: // P – 1 -> P
					p -= 0x01; p &= 0x0F;
					break;
				case 0b00001010: // DISPLAY TOGGLE
					disp_enable = !disp_enable; disp_update = 1;
					break;
				case 0b00101010: // C EXCHANGE M
					reg_move(C, M, 1, 0, 13);
					break;
				case 0b01001010: // C -> STACK
					reg_move(F, E, 0, 0, 13); reg_move(E, D, 0, 0, 13); reg_move(D, C, 0, 0, 13);
					break;
				case 0b01101010: // STACK -> A
					reg_move(A, D, 0, 0, 13); reg_move(D, E, 0, 0, 13); reg_move(E, F, 0, 0, 13);
					break;
				case 0b10001010: // DISPLAY OFF
					if (disp_enable) { disp_enable = 0; disp_update = 1; }
					break;
				case 0b10101010: // M -> C
					hpvm_iterate_word(C[i] = M[i]);
					break;
				case 0b11001010: // DOWN ROTATE
					reg_move(C, D, 1, 0, 13); reg_move(D, E, 1, 0, 13); reg_move(E, F, 1, 0, 13);
					break;
				case 0b11101010: // CLEAR REGISTERS
					reg_clr(A, 0, 13); reg_clr(B, 0, 13); reg_clr(C, 0, 13); reg_clr(D, 0, 13); reg_clr(E, 0, 13); reg_clr(F, 0, 13); reg_clr(M, 0, 13);
					break;
				case 0b00001100: // RETURN
					pc = ret_pc;
					break;
				case 0b00001101: // CLEAR STATUS
					for (uint8_t i = 0; i < 12; i++) s[i] = 0;
					break;
				case 0b00001111: // P + 1 -> P
					p += 0x01; p &= 0x0F;
					break;
				default:
					uint8_t nnnn = op_code >> 4;
					switch(op_code & 0x0F)
					{
						case 0b0001: // 1 -> Sn
							s[nnnn] = 1;
							break;
						case 0b0011: // n -> P
							p = nnnn;
							break;
						case 0b0100: // ROM SELECT n
							rom = (nnnn >> 1);
							break;
						case 0b0101: // IF Sn = 0
							carry = s[nnnn];
							break;
						case 0b0110: // n -> C
							C[p] = nnnn; p -= 0x01; p &= 0x0F;
							break;
						case 0b1001: // 0 -> Sn
							s[nnnn] = 0;
							break;
						case 0b1011: // IF p # n
							carry = (p == nnnn);
							break;
					}
			}
		}

		// Type 01: Branching Instructions
		else if (op_type == 0x01)
		{
			// JSB addr
			ret_pc = pc;
			pc = op_code;
		}

		// Type 10: Arithmetic Instructions
		else if (op_type == 0x02)
		{
			// get register boundaries
			uint8_t f = op_code & 0x07;
			uint8_t bounds;
			if (f == fld::P) bounds = uint8_t(p << 4) | p;
			else if (f == fld::WP) bounds = p;
			else bounds = pgm_read_byte(field_bounds + f);
			ff = bounds >> 4;
			fl = bounds & 0x0F;

			// process opcode
			uint8_t desc = pgm_read_byte(arith_desc + (op_code >> 3));
			uint8_t arg = desc & 0x0F;
			digit *r0;
			digit *r1;
			digit *r2;
			switch (desc >> 4)
			{
				case 0: // test zero/nonzero
					r0 = (arg & 3) == 0 ? A : ((arg & 3) == 1 ? B : C);
					carry = (arg & 4) != 0;
					if (arg & 4) { hpvm_iterate_field(carry &= (r0[i] == 0)); }
					else { hpvm_iterate_field(carry |= (r0[i] != 0)); }
					break;
				case 1: // clear
					r0 = arg == 0 ? A : (arg == 1 ? B : C);
					reg_clr(r0, ff, fl);
					break;
				case 2: // compare A >= r
					r0 = arg == 1 ? B : C;
					hpvm_iterate_field(alu(A[i], r0[i], 1));
					break;
				case 3: // copy
					r0 = (arg >> 2) == 0 ? A : ((arg >> 2) == 1 ? B : C);
					r1 = (arg & 3) == 0 ? A : ((arg & 3) == 1 ? B : C);
					reg_move(r0, r1, 0, ff, fl);
					break;
				case 4: // 0-C[-1] -> C
					carry = arg;
					hpvm_iterate_field(C[i] = alu(0, C[i], 1));
					break;
				case 5: // shift left A
					reg_shl(A);
					break;
				case 6: // subtract
					r0 = arg == 0 ? C : A;
					r1 = arg == 1 ? B : C;
					reg_math(r0, A, r1, 1);
					break;
				case 7: // decrement
					r0 = arg == 0 ? A : C;
					carry = 1; reg_math(r0, r0, 0, 1);
					break;
				case 8: // add
					r0 = arg < 2 ? C : A;
					r1 = arg == 0 ? A : r0;
					r2 = arg == 2 ? B : C;
					reg_math(r0, r1, r2, 0);
					break;
				case 9: // increment
					r0 = arg == 0 ? A : C;
					carry = 1; reg_math(r0, r0, 0, 0);
					break;
				case 10: // swap
					if (arg == 0) reg_move(B, C, 1, ff, fl);
					else if (arg == 1) reg_move(A, B, 1, ff, fl);
					else reg_move(A, C, 1, ff, fl);
					break;
				case 11: // shift right
					r0 = arg == 0 ? A : (arg == 1 ? B : C);
					reg_shr(r0);
					break;
			}

		}

		// Type 11: Branching Instructions
		else // op_type == 0x03
		{
			// (THEN) GO TO addr
			if (!prev_carry)
			{
				pc = op_code;
			}
		}

		// display update
		if (disp_update)
		{
			disp_update = 0;
			for (uint8_t d = 0, i = 14; i--; )
			{
				if (disp_enable)
				{
					if (B[i] == 9)
						Display[d++] = HPVM_SPACE;
					else if (i == 2 || i == 13)
						Display[d++] = (A[i] == 9 ? HPVM_DASH : HPVM_SPACE);
					else
						Display[d++] = HPVM_DIGIT + A[i];
					if (B[i] == 2)
						Display[d++] = HPVM_DOT;
				}
				else
					Display[d++] = HPVM_SPACE;
			}
			return true;
		}
		return false;
	}
}
